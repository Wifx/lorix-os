## layers/bsp/meta-atmel-wifx/conf/layer.conf
```bitbake
# We have a conf and classes directory, append to BBPATH
BBPATH .= ":${LAYERDIR}"

# We have a recipes directory, add to BBFILES
BBFILES += "${LAYERDIR}/recipes*/*/*.bb ${LAYERDIR}/recipes*/*/*.bbappend"

BBFILE_COLLECTIONS += "atmel-wifx"
BBFILE_PATTERN_atmel-wifx := "^${LAYERDIR}/"
BBFILE_PRIORITY_atmel-wifx = "11"

LICENSE_PATH += "${LAYERDIR}/licenses"

LAYERSERIES_COMPAT_atmel-wifx = "zeus"
LAYERDEPENDS_atmel-wifx = "atmel"
```

## layers/bsp/meta-atmel-wifx/conf/machine/include/lorix-one.inc
```bitbake
# Copyright (c) 2019-2020, Wifx Sàrl <info@wifx.net>
# All rights reserved.

# The CPU of the LORIX One is an SAMA5D41 from Microchip (Atmel)
require sama5d4-wifx.inc

# the machine is more generally a Wifx LORIX One
MACHINEOVERRIDES =. "lorix-one:"
```

## layers/bsp/meta-atmel-wifx/conf/machine/include/sama5d4-wifx.inc
```bitbake
# Copyright (c) 2019-2020, Wifx Sàrl <info@wifx.net>
# All rights reserved.

require conf/machine/include/sama5d4.inc

# the machine is more generally a Wifx product based on SAMA5D4 CPU
MACHINEOVERRIDES =. "sama5d4-wifx:"

# Perhaps wimg and tar.bz2 could be moved in distro or image recipe
IMAGE_FSTYPES += "ubimg wimg tar.bz2"

# Preferred providers
PREFERRED_PROVIDER_virtual/firststage_sama5 = "at91bootstrap"
PREFERRED_PROVIDER_virtual/bootloader_sama5 = "u-boot-at91"
PREFERRED_PROVIDER_u-boot_sama5 = "u-boot-at91"

# Avoid using new at91boostrap v4 which is completely different
PREFERRED_VERSION_at91bootstrap_sama5 = "3.%"

# Linux kernel specific variables
KERNEL_DEVICETREE ?= "${MACHINE}.dtb"
KERNEL_IMAGETYPE = "zImage"

# U-Boot bootloader specific variables
UBOOT_MACHINE ?= "${@'${MACHINE}'.replace('-', '_')}_nandflash_config"
UBOOT_ENTRYPOINT = "0x20008000"
UBOOT_LOADADDRESS = "0x20008000"
UBOOT_ENV_SIZE = "0x20000"
UBOOT_ENV_SECTOR_COUNT = "2"

# Mender update system specific variables
MENDER_MTDIDS = "nand0=atmel_nand"
MENDER_MTDPARTS = "atmel_nand:256k(bootstrap)ro,768k(uboot)ro,512k(uboot-env),-(ubi)"
MENDER_BOOT_PART_SIZE_MB = "0"
MENDER_RESERVED_SPACE_BOOTLOADER_DATA = "0x180000"
MENDER_UBOOT_ENV_STORAGE_DEVICE_OFFSET_1 = "0x140000"
MENDER_UBOOT_ENV_STORAGE_DEVICE_OFFSET_2 = "0x100000"
MENDER_UBOOT_ENV_STORAGE_DEVICE_1 = "mtd2"
MENDER_UBOOT_ENV_STORAGE_DEVICE_2 = "mtd2"
MENDER_UBOOT_ENV_STORAGE_PARTITION_OFFSET_1 = "0x00000"
MENDER_UBOOT_ENV_STORAGE_PARTITION_OFFSET_2 = "0x40000"
BOOTENV_SIZE = "${UBOOT_ENV_SIZE}"

# used by sysvinit_2
SERIAL_CONSOLES = "115200;ttyS0 115200;ttyGS0"
SYSVINIT_ENABLED_GETTYS = ""
USE_VT = "0"

MACHINE_FEATURES += "rtc usbgadget usbhost"
MACHINE_EXTRA_RRECOMMENDS += "mtd-utils mtd-utils-ubifs"

# Packages required ideally at boot (as rrecommend and not rdepends to avoid build error on kernel version change)
MACHINE_ESSENTIAL_EXTRA_RRECOMMENDS += "kernel-devicetree kernel-image"
MACHINE_ESSENTIAL_EXTRA_RDEPENDS += "kernel-modules"

# make sure that kernel and devicetree are installed
IMAGE_INSTALL_append = " kernel-devicetree kernel-image-zimage"

# Remove unused dependency which makes the build fail during the do_fetch
EXTRA_IMAGEDEPENDS_remove = "sam-ba-native"
```

## layers/bsp/meta-atmel-wifx/conf/machine/lorix-one-512.conf
```bitbake
# Copyright (c) 2019-2020, Wifx Sàrl <info@wifx.net>
# All rights reserved.

#@TYPE: Machine
#@Name: WIFX SAMA5D4 LORIX One (512MB NAND version)
#@DESCRIPTION: Machine configuration for Wifx LoRa gateway - LORIX One 512MB

# The LORIX One base
require include/lorix-one.inc

KERNEL_DEVICETREE = "lorix-one-512.dtb"
KERNEL_IMAGETYPE = "zImage"

# Wifx archive image parameters
WIMG_DEVICE_NAND_HEADER = "0xc1e04e07"
WIMG_DEVICE_ERASE_BLK = "0x40000"

# NAND
MKUBIFS_ARGS ?= " -e 0x3e000 -c 4096 -m 0x1000 -x lzo"
UBINIZE_ARGS ?= " -m 0x1000 -p 0x40000 -s 4096"

#UBI_VOLNAME = "rootfs"
UBI_ROOTFS_SIZE_MB = "64"

# 512MB of NAND flash minus bootloader area
MENDER_STORAGE_TOTAL_SIZE_MB = "510"
# 300MB for data partition
MENDER_DATA_PART_SIZE_MB = "200"
# align to PEB size 256K
MENDER_STORAGE_PEB_SIZE = "262144"
# Account for UBI overhead, see
# http://www.linux-mtd.infradead.org/doc/ubi.html#L_overhead for details,
MENDER_PARTITIONING_OVERHEAD_KB = "26256"
```

## layers/meta-mender-wifx/conf/layer.conf
```bitbake
# Layer configuration for meta-mender
# Copyright 2017 Northern.tech AS

# We have a conf and classes directory, append to BBPATH
BBPATH .= ":${LAYERDIR}"

# We have a recipes directory, add to BBFILES
BBFILES += "${LAYERDIR}/recipes*/*/*.bb ${LAYERDIR}/recipes*/*/*.bbappend"

BBFILE_COLLECTIONS += "mender-wifx"
BBFILE_PATTERN_mender-wifx := "^${LAYERDIR}/"
BBFILE_PRIORITY_mender-wifx = "7"

LAYERSERIES_COMPAT_mender-wifx = "dunfell"
LAYERDEPENDS_mender-wifx = "mender"

MENDER_ARTIFACT_NAME = "${RELEASE_ARTIFACT_NAME}"
```

## layers/meta-openrc-app/conf/layer.conf
```bitbake
# We have a conf and classes directory, append to BBPATH
BBPATH .= ":${LAYERDIR}"

# We have a recipes directory, add to BBFILES
BBFILES += "${LAYERDIR}/recipes-*/*/*.bb ${LAYERDIR}/recipes-*/*/*.bbappend"

BBFILE_COLLECTIONS += "openrc-app"
BBFILE_PATTERN_openrc-app := "^${LAYERDIR}/"
BBFILE_PRIORITY_openrc-app = "5"

OPENRC_INITDIR = "${sysconfdir}/openrc.d"
OPENRC_CONFDIR = "${sysconfdir}/conf.d"

LAYERSERIES_COMPAT_openrc-app = "zeus"
LAYERDEPENDS_openrc-app = "openrc"
```

## layers/meta-openrc-wifx/conf/layer.conf
```bitbake
# We have a conf and classes directory, append to BBPATH
BBPATH .= ":${LAYERDIR}"

# We have a recipes directory, add to BBFILES
#BBFILES += "${LAYERDIR}/recipes-*/*/*.bb ${LAYERDIR}/recipes-*/*/*.bbappend"

BBFILE_COLLECTIONS += "openrc-wifx"
BBFILE_PATTERN_openrc-wifx := "^${LAYERDIR}/"
BBFILE_PRIORITY_openrc-wifx = "5"

OPENRC_INITDIR = "${sysconfdir}/openrc.d"
OPENRC_CONFDIR = "${sysconfdir}/conf.d"

PREFERRED_RPROVIDER_sysvinit-pidof = "openrc-sysvinit"

LAYERSERIES_COMPAT_openrc-wifx = "zeus"
```

## layers/target/meta-wifx-machine/conf/machine/include/lorix-one-base.inc
```bitbake
# The CPU of the LORIX One is an SAMA5D41 from Microchip (Atmel)
require sama5d4.inc

# Preferred providers
PREFERRED_PROVIDER_virtual/bootloader_sama5 = "u-boot-wifx"
PREFERRED_PROVIDER_u-boot_sama5 = "u-boot-wifx"
PREFERRED_PROVIDER_virtual/kernel_sama5 = "linux-at91"
PREFERRED_PROVIDER_u-boot-fw-utils = "u-boot-wifx-fw-utils"
PREFERRED_PROVIDER_u-boot-mkenvimage-native = "u-boot-mkenvimage-native"
PREFERRED_VERSION_linux-at91_sama5 = "5.4%"

# used by sysvinit_2
SERIAL_CONSOLES = "115200;ttyS0 115200;ttyGS0"
SYSVINIT_ENABLED_GETTYS = ""
USE_VT = "0"

MACHINE_FEATURES = "rtc usbgadget usbhost lora"
MACHINE_EXTRA_RRECOMMENDS += "mtd-utils mtd-utils-ubifs"

# Packages required ideally at boot (as rrecommend and not rdepends to avoid build error on kernel version change)
MACHINE_ESSENTIAL_EXTRA_RRECOMMENDS += "kernel-devicetree kernel-image"
MACHINE_ESSENTIAL_EXTRA_RDEPENDS += "kernel-modules"

# make sure that kernel and devicetree are installed
IMAGE_INSTALL_append = " kernel-devicetree kernel-image-zimage"

MACHINE_FEATURES += "sx1301"
```

## layers/target/meta-wifx-machine/conf/machine/include/lorix-one.inc
```bitbake
# Copyright (c) 2019, Wifx Sàrl <info@wifx.net>
# All rights reserved.

# The CPU of the LORIX One is a SAMA5D41 from Microchip (Atmel)
require conf/machine/include/sama5d4-wifx.inc

# the machine is more generally a Wifx LORIX One (mem size apart)
MACHINEOVERRIDES =. "lorix-one:"

MACHINE_FEATURES_OVERRIDES += "sx1301"

MACHINE_PRETTY_NAME = "LORIX One"
```

## layers/target/meta-wifx-machine/conf/machine/l1.conf
```bitbake
# Copyright (c) 2019-2020, Wifx Sàrl <info@wifx.net>
# All rights reserved.

#@TYPE: Machine
#@Name: SAMA5D4 Wifx L1
#@DESCRIPTION: Machine configuration for Wifx LoRa gateway board - Wifx L1

# The CPU of the L1 is an SAMA5D41 from Microchip (Atmel)
require conf/machine/include/sama5d4-wifx.inc

# the machine is more generally a Wifx L1
MACHINEOVERRIDES =. "l1:"

MACHINE_FEATURES_OVERRIDES += "sx1302"

# Wifx archive image parameters
WIMG_DEVICE_NAND_HEADER = "0xc0902405"
WIMG_DEVICE_ERASE_BLK = "0x20000"

# NAND
MKUBIFS_ARGS ?= " -m 0x800 -e 0x1f000 -c 4000 -x lzo"
UBINIZE_ARGS ?= " -m 0x800 -p 0x20000 -s 2048"

#UBI_VOLNAME = "rootfs"
UBI_ROOTFS_SIZE_MB = "64"

# 1022MB of NAND flash minus bootloader area
MENDER_STORAGE_TOTAL_SIZE_MB = "1022"
# 512MB for data partition
MENDER_DATA_PART_SIZE_MB = "512"
# align to PEB size 128K
MENDER_STORAGE_PEB_SIZE = "131072"
# Account for UBI overhead, see
# http://www.linux-mtd.infradead.org/doc/ubi.html#L_overhead for details,
MENDER_PARTITIONING_OVERHEAD_KB = "53056"

# These packages will not be installed but availalbe through OPKG
BAD_RECOMMENDATIONS += " \
    helium-gateway \
    pmon-helium-csub-concentratord \
    zabbix \
"
```

## layers/target/meta-wifx-machine/conf/machine/lorix-one-256.conf
```bitbake
# Copyright (c) 2019-2020, Wifx Sàrl <info@wifx.net>
# All rights reserved.

#@TYPE: Machine
#@Name: WIFX SAMA5D4 LORIX One (256MB NAND version)
#@DESCRIPTION: Machine configuration for Wifx LoRa gateway - LORIX One 256MB

# The LORIX One base
require include/lorix-one.inc
MACHINE_PRETTY_NAME_LONG = "LORIX One (256MB)"

# Wifx archive image parameters
WIMG_DEVICE_NAND_HEADER = "0xc0902405"
WIMG_DEVICE_ERASE_BLK = "0x20000"

# NAND
MKUBIFS_ARGS ?= " -e 0x1f000 -c 2048 -m 0x800 -x lzo"
UBINIZE_ARGS ?= " -m 0x800 -p 0x20000 -s 2048"

# Used as fallback if Mender is disabled
UBI_ROOTFS_SIZE_MB = "256"

# 256MB of NAND flash minus bootloader area and 4 reserved PEBs for bad PEB handling
MENDER_STORAGE_TOTAL_SIZE_MB = "254"
# 57MB for data partition
MENDER_DATA_PART_SIZE_MB = "57"
# align to PEB size 128k
MENDER_STORAGE_PEB_SIZE = "131072"
# Account for UBI overhead, see
# http://www.linux-mtd.infradead.org/doc/ubi.html#L_overhead for details,
MENDER_PARTITIONING_OVERHEAD_KB = "13104"

COMPRESS_BINARIES_UPX = "true"

BAD_RECOMMENDATIONS_append = " \
    net-snmp-server \
" 
```

## layers/target/meta-wifx-machine/conf/machine/lorix-one-512.conf
```bitbake
#@TYPE: Machine
#@Name: WIFX SAMA5D4 LORIX One (512MB NAND version)
#@DESCRIPTION: Machine configuration for Wifx LoRa gateway board - LORIX One

# The LORIX One base
require include/lorix-one-base.inc

# Uncomment the following line to generate a SD card image
# MACHINE_FEATURES += " sdimg"

KERNEL_DEVICETREE = "lorix-one-512.dtb"
KERNEL_IMAGETYPE = "zImage"

IMAGE_FSTYPES += " ubimg wimg tar.bz2"

# Wifx archive image parameters
WIMG_DEVICE_NAND_HEADER = "0xc1e04e07"
WIMG_DEVICE_ERASE_BLK = "0x40000"

# NAND
MKUBIFS_ARGS ?= " -e 0x3e000 -c 4096 -m 0x1000 -x lzo"
UBINIZE_ARGS ?= " -m 0x1000 -p 0x40000 -s 4096"

#UBI_VOLNAME = "rootfs"
UBI_ROOTFS_SIZE_MB = "64"

UBOOT_MACHINE ?= "lorix_one_512_nandflash_config"
UBOOT_ENTRYPOINT = "0x20008000"
UBOOT_LOADADDRESS = "0x20008000"

# Mender section
MENDER_MTDIDS = "nand0=atmel_nand"
MENDER_MTDPARTS = "atmel_nand:256k(bootstrap)ro,768k(uboot)ro,512k(uboot-env),-(ubi)"

MENDER_BOOT_PART_SIZE_MB = "0"
MENDER_RESERVED_SPACE_BOOTLOADER_DATA = "0x180000"

# 512MB of NAND flash minus bootloader area
MENDER_STORAGE_TOTAL_SIZE_MB = "510"
# 300MB for data partition
MENDER_DATA_PART_SIZE_MB = "200"
# align to PEB size 256K
MENDER_STORAGE_PEB_SIZE = "262144"
# Account for UBI overhead, see
# http://www.linux-mtd.infradead.org/doc/ubi.html#L_overhead for details,
MENDER_PARTITIONING_OVERHEAD_KB = "26256"

MENDER_UBOOT_ENV_STORAGE_DEVICE_OFFSET_1 = "0x140000"
MENDER_UBOOT_ENV_STORAGE_DEVICE_OFFSET_2 = "0x100000"
```

## meta-wifx-lorix/conf/layer.conf
```bitbake
# We have a conf and classes directory, append to BBPATH
BBPATH .= ":${LAYERDIR}"

# We have a recipes directory, add to BBFILES
BBFILES += "${LAYERDIR}/recipes*/*/*.bb ${LAYERDIR}/recipes*/*/*.bbappend"

BBFILE_COLLECTIONS += "wifx-lorix"
BBFILE_PATTERN_wifx-lorix := "^${LAYERDIR}/"
BBFILE_PRIORITY_wifx-lorix = "12"

LICENSE_PATH += "${LAYERDIR}/licenses"

LAYERSERIES_COMPAT_wifx-lorix = "zeus"
```

## meta-wifx-lorix/conf/machine/lorix-one-256.conf
```bitbake
#@TYPE: Machine
#@Name: WIFX SAMA5D4 LORIX One (256MB NAND version)
#@DESCRIPTION: Machine configuration for Wifx LoRa gateway board - LORIX One

# The LORIX One base
require include/lorix-one-base.inc

# Uncomment the following line to generate a SD card image
# MACHINE_FEATURES += " sdimg"

# Bad OS package recommendation
BAD_RECOMMENDATIONS = "net-snmp-server"

KERNEL_DEVICETREE = "lorix-one-256.dtb"
KERNEL_IMAGETYPE = "zImage"

IMAGE_FSTYPES += " ubimg wimg"

# Wifx archive image parameters
WIMG_DEVICE_NAND_HEADER = "0xc0902405"
WIMG_DEVICE_ERASE_BLK = "0x20000"

# NAND
MKUBIFS_ARGS ?= " -e 0x1f000 -c 2048 -m 0x800 -x lzo"
UBINIZE_ARGS ?= " -m 0x800 -p 0x20000 -s 2048"

#UBI_VOLNAME = "rootfs"
UBI_ROOTFS_SIZE_MB = "64"

UBOOT_MACHINE ?= "lorix_one_256_nandflash_config"
UBOOT_ENTRYPOINT = "0x20008000"
UBOOT_LOADADDRESS = "0x20008000"

# Mender section
MENDER_MTDIDS = "nand0=atmel_nand"
MENDER_MTDPARTS = "atmel_nand:256k(bootstrap)ro,768k(uboot)ro,512k(uboot-env),-(ubi)"

MENDER_BOOT_PART_SIZE_MB = "0"
MENDER_RESERVED_SPACE_BOOTLOADER_DATA = "0x180000"

# 256MB of NAND flash minus bootloader area and 4 reserved PEBs for bad PEB handling
MENDER_STORAGE_TOTAL_SIZE_MB = "254"
# 57MB for data partition
MENDER_DATA_PART_SIZE_MB = "57"
# align to PEB size 128k
MENDER_STORAGE_PEB_SIZE = "131072"
# Account for UBI overhead, see
# http://www.linux-mtd.infradead.org/doc/ubi.html#L_overhead for details,
MENDER_PARTITIONING_OVERHEAD_KB = "13104"

MENDER_UBOOT_ENV_STORAGE_DEVICE_OFFSET_1 = "0x140000"
MENDER_UBOOT_ENV_STORAGE_DEVICE_OFFSET_2 = "0x100000"
```

## meta-wifx-mender/conf/layer.conf
```bitbake
# Layer configuration for meta-mender
# Copyright 2017 Northern.tech AS

# We have a conf and classes directory, append to BBPATH
BBPATH .= ":${LAYERDIR}"

# Save layerdir for use in functions outside .conf scope
LAYERDIR_MENDER := "${LAYERDIR}"

# We have a recipes directory, add to BBFILES
BBFILES += "${LAYERDIR}/recipes*/*/*.bb ${LAYERDIR}/recipes*/*/*.bbappend"

BBFILE_COLLECTIONS += "wifx-mender"
BBFILE_PATTERN_wifx-mender := "^${LAYERDIR}/"
BBFILE_PRIORITY_wifx-mender = "11"

INHERIT += "mender-setup"

LAYERSERIES_COMPAT_wifx-mender = "zeus"

DISTRO_FEATURES_append = " mender"
CORE_IMAGE_EXTRA_INSTALL_append = " mender-client mender-artifact-info mender-state-scripts-base mender-migrations"
MENDER_ARTIFACT_NAME = "${RELEASE_ARTIFACT_NAME}"
```

## meta-wifx-openrc/conf/layer.conf
```bitbake
# We have a conf and classes directory, append to BBPATH
BBPATH .= ":${LAYERDIR}"

# We have a recipes directory, add to BBFILES
BBFILES += "${LAYERDIR}/recipes-*/*/*.bb ${LAYERDIR}/recipes-*/*/*.bbappend"

BBFILE_COLLECTIONS += "wifx-openrc"
BBFILE_PATTERN_wifx-openrc := "^${LAYERDIR}/"
BBFILE_PRIORITY_wifx-openrc = "8"

OPENRC_INITDIR = "${sysconfdir}/openrc.d"
OPENRC_CONFDIR = "${sysconfdir}/conf.d"

PREFERRED_RPROVIDER_sysvinit-pidof = "openrc-sysvinit"

LAYERSERIES_COMPAT_wifx-openrc = "zeus"
```

## meta-wifx/conf/layer.conf
```bitbake
# We have a conf and classes directory, append to BBPATH
BBPATH .= ":${LAYERDIR}"

# We have a recipes directory, add to BBFILES
BBFILES += "${LAYERDIR}/recipes*/*/*.bb ${LAYERDIR}/recipes*/*/*.bbappend"

BBFILE_COLLECTIONS += "wifx"
BBFILE_PATTERN_wifx := "^${LAYERDIR}/"
BBFILE_PRIORITY_wifx = "10"

LICENSE_PATH += "${LAYERDIR}/licenses"

INHERIT += "wifx-setup"

LAYERSERIES_COMPAT_wifx = "zeus"
```

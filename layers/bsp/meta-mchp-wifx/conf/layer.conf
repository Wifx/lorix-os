## meta/conf/distro/lorix-os.conf
```bitbake
# Based on poky distro
require include/wifx-base.inc

# Include OS version if possible
include ${TOPDIR}/../../release.conf

# And inherits from OS setup class (for sanity checks for example)
INHERIT += "os-setup"

# Version values
DISTRO = "lorix-os"
DISTRO_NAME = "LORIX OS (Wifx LORIX family products operating system)"
# Works with "lorix-os" Yocto distro
OS_DISTRO_VERSION ??= "x.x.x"
OS_DISTRO_CODENAME ??= "no codename"
OS_DISTRO_FEEDS_BASE_URL ??= "https://download.wifx.net/lorix-os"

OS_DISTRO_UPGRADE_COMPATIBLE_VERSIONS ??= "<=${OS_DISTRO_VERSION}"

# Override standard distro values
DISTRO_VERSION = "${OS_DISTRO_VERSION}"
DISTRO_CODENAME = "${OS_DISTRO_CODENAME}"
# Distro URLs
DISTRO_FEEDS_BASE_URL = "${OS_DISTRO_FEEDS_BASE_URL}"
DISTRO_RELEASE_BASE_URL = "${DISTRO_FEEDS_BASE_URL}/${DISTRO_VERSION}"

SDK_VENDOR = "-lorixossdk"
SDK_VERSION := "${@'${DISTRO_VERSION}'.replace('snapshot-${DATE}','snapshot')}"
TARGET_VENDOR = "-lorixos"

MAINTAINER = "Wifx Sàrl <support@iot.wifx.net>"

# Add some features
DISTRO_FEATURES:append = " \
	ipv6 \
	ppp \
	openrc \
	pam \
	motd-dynamic \
	zeroconf \
	wireguard \
	pmonitor \
	manager \
	connection-profiles \
"

# OPKG feed configuration
DISTRO_FEED_URI = "${DISTRO_FEEDS_BASE_URL}/${DISTRO_VERSION}/feeds"
DISTRO_FEED_PREFIX = "remote"
DISTRO_FEED_ARCHS = "all ${TUNE_PKGARCH} ${MACHINE_ARCH}"

# Remove useless distribution features
DISTRO_FEATURES:remove ?= " \
	largefile opengl ptest multiarch wayland vulkan \
	alsa bluetooth ext2 irda pcmcia wifi pci 3g nfc x11 vfat \
"

# Virtual managers
VIRTUAL-RUNTIME_init_manager = "openrc-sysvinit"
VIRTUAL-RUNTIME_dev_manager = "eudev"
VIRTUAL-RUNTIME_process_manager = "openrc"
VIRTUAL-RUNTIME_initscripts = ""
VIRTUAL-RUNTIME_syslog = "syslog-ng"
VIRTUAL-RUNTIME_login_manager = "shadow"
VIRTUAL-RUNTIME_base-utils = "busybox"
VIRTUAL-RUNTIME_base-utils-hwclock = "busybox-hwclock"

# Preferred runtime providers
PREFERRED_RPROVIDER_virtual/udp-packet-forwarder ?= "udp-packet-forwarder"
PREFERRED_RPROVIDER_virtual/usb-gadget ?= "usb-gadget-serial-rndis"

PREFERRED_PROVIDER_mender-native =  "mender-native"
PREFERRED_RPROVIDER_mender =   		"mender"
PREFERRED_RPROVIDER_mender-auth =   "mender"
PREFERRED_RPROVIDER_mender-update = "mender"

#PREFERRED_VERSION_mender ?= "4.0.4"
PREFERRED_VERSION_mender ?= "5.0.0-build6"

GOVERSION = "1.20%"
GO_DYNLINK:arm = ""

PREFERRED_VERSION_chirpstack-concentratord ?= "3%"

# Only enable US English version to reduce size
IMAGE_LINGUAS ?= "en-us"
GLIBC_GENERATE_LOCALES = "en_US.UTF-8"
ENABLE_BINARY_LOCALE_GENERATION ?= "1"

EXTRA_OECONF:remove = "${DISABLE_STATIC}"

# Additionnal target filesystem path
export optdir = "/opt"
export sysconfoptdir = "/etc/opt"
```
